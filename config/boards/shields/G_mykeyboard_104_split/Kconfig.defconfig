## config/boards/shields/G_mykeyboard_104_split/Kconfig.defconfig
```kconfig
if SHIELD_G_MYKEYBOARD_104_SPLIT

config ZMK_KEYBOARD_NAME
    default "GKB104"

config I2C
    default y

config GPIO
    default y

config GPIO_PCA953X
    default y

endif
```

## config/config/boards/shields/G_mykeyboard_104_split/Kconfig.defconfig
```kconfig
if SHIELD_G_MYKEYBOARD_104_SPLIT

config ZMK_KEYBOARD_NAME
    default "G_mykeyboard_104"

config I2C
    default y

config GPIO
    default y

config GPIO_PCA953X
    default y

config EC11
    default y

config EC11_TRIGGER_GLOBAL_THREAD
    default y

endif
```
