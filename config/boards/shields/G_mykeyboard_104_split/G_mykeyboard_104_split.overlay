&i2c1 {
    status = "okay";

    clock-frequency = <I2C_BITRATE_STANDARD>;

    tca9555_u1: tca9555@20 {
        compatible = "nxp,pca9555";
        reg = <0x20>;
        gpio-controller;
        #gpio-cells = <2>;
        ngpios = <16>;
        status = "okay";
    };
};
